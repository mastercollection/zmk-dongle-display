## config/west.yml
```yaml
manifest:
  remotes:
    - name: zmkfirmware
      url-base: https://github.com/zmkfirmware
    - name: mastercollection
      url-base: https://github.com/mastercollection
  projects:
    - name: zmk
      remote: zmkfirmware
      revision: main
      import: app/west.yml
    - name: zmk-config
      remote: mastercollection
      revision: main
  self:
    path: config
```
